## drivers/sensor/hcsrc04trig/Kconfig
```kconfig
# HCSR04TRIG Ultrasound sensor configuration options

# Copyright (c) 2024 Adrien Leravat
# SPDX-License-Identifier: Apache-2.0

config HCSRC04TRIG
        bool "HCSRC04TRIG Ultrasound distance sensor"
        default y
        depends on DT_HAS_HCSR04TRIG_ENABLED
        depends on GPIO
        help
          Enable driver for HCSR04TRIG distance sensor.
```

## dts/bindings/sensor/esiroi,hcsrc04trig.yaml
```yaml
# Copyright (c) 2024, Adrien Leravat
# SPDX-License-Identifier: Apache-2.0

description: HC-SR04 with one wire from both trig and echo.

compatible: "hcsr04trig"

include: sensor-device.yaml

properties:
  trigger-gpios:
    type: phandle-array
    required: true
    description: |
      Output pin used to trigger the distance measurement.
```
